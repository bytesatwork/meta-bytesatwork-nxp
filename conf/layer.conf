## conf/layer.conf
```bitbake
# Copyright (C) 2022 bytes at work AG - https://www.bytesatwork.io
# Released under the MIT license (see COPYING.MIT for the terms)

# We have a conf and classes directory, add to BBPATH
BBPATH =. "${LAYERDIR}:"

# We have recipes-* directories, add to BBFILES
BBFILES += "${LAYERDIR}/recipes-*/*/*.bb \
            ${LAYERDIR}/recipes-*/*/*.bbappend"

BBFILE_COLLECTIONS += "meta-bytesatwork-nxp"
BBFILE_PATTERN_meta-bytesatwork-nxp = "^${LAYERDIR}/"
BBFILE_PRIORITY_meta-bytesatwork-nxp = "8"

LAYERDEPENDS_meta-bytesatwork-nxp = " \
	freescale-layer \
"

LAYERSERIES_COMPAT_meta-bytesatwork-nxp = "kirkstone"
```

## conf/machine/bytedevkit-imx8mm.conf
```bitbake
# Copyright (C) 2022 bytes at work AG - https://www.bytesatwork.io
# Released under the MIT license (see COPYING.MIT for the terms)

#@TYPE: Machine
#@NAME: byteDEVKIT IMX8MM
#@DESCRIPTION: byteDEVKIT IMX8MM by bytes at work AG

require include/byteengine-imx8mm.inc

MACHINE_FEATURES:remove = "fip"
MACHINE_FEATURES:remove = "optee"

KERNEL_DEFCONFIG = "bytedevkit_imx8mm_defconfig"
KERNEL_DEVICETREE = "freescale/imx8mm-bytedevkit.dtb"

UBOOT_CONFIG ??= "sd"
UBOOT_CONFIG[sd] = "bytedevkit_defconfig,sdcard"
UBOOT_CONFIG[fspi] = "bytedevkit_fspi_defconfig"

# Set u-boot DTB
UBOOT_DTB_NAME = "imx8mm-bytedevkit.dtb"

# Set imx-mkimage boot target
IMXBOOT_TARGETS = "${@bb.utils.contains('UBOOT_CONFIG', 'fspi', 'flash_evk_flexspi', 'flash_evk', d)}"

# Set Serial console (aliased in dt from uart2)
SERIAL_CONSOLES = "115200;ttymxc0"

WKS_FILE = "byteengine-imx8mm-sdcard.wks.in"
```
