## conf/machine/bytedevkit-imx93.conf
```bitbake
# Copyright (C) 2024 bytesatwork AG - https://www.bytesatwork.io
# Released under the MIT license (see COPYING.MIT for the terms)

#@TYPE: Machine
#@NAME: byteDEVKIT IMX93
#@DESCRIPTION: byteDEVKIT IMX93 by bytesatwork AG

require include/byteengine-imx93.inc

KERNEL_DEFCONFIG = "bytedevkit_imx93_defconfig"
KERNEL_DEVICETREE = "freescale/${KERNEL_DEVICETREE_BASENAME}.dtb"
KERNEL_DEVICETREE_BASENAME = "imx93-bytedevkit"

UBOOT_CONFIG ??= "sd"
UBOOT_CONFIG[sd]   = "${UBOOT_CONFIG_BASENAME}_defconfig,sdcard"
UBOOT_DTB_NAME = "${KERNEL_DEVICETREE_BASENAME}.dtb"

IMXBOOT_TARGETS = "flash_singleboot"

SERIAL_CONSOLES = "115200;ttyLP0"

WKS_FILE = "byteengine-imx93-sdcard.wks.in"
```

## conf/machine/include/byteengine-imx8mm.inc
```bitbake
# Copyright (C) 2024 bytesatwork AG - https://www.bytesatwork.io
# Released under the MIT license (see COPYING.MIT for the terms)

#@TYPE: Machine
#@NAME: byteENGINE IMX8MM
#@DESCRIPTION: byteENGINE IMX8MM by bytesatwork AG

MACHINEOVERRIDES =. "mx8:mx8m:mx8mm:"

require conf/machine/include/imx-base.inc
require conf/machine/include/arm/armv8a/tune-cortexa53.inc

IMX_DEFAULT_BSP = "nxp"
IMX_DEFAULT_BOOTLOADER:use-nxp-bsp = "u-boot-imx"

MACHINE_FEATURES += "pci wifi bluetooth optee"

KERNEL_IMAGETYPES = "Image"

MACHINE_USES_VIVANTE_KERNEL_DRIVER_MODULE = "1"
SPL_BINARY = "spl/u-boot-spl.bin"

# Set DDR FIRMWARE
DDR_FIRMWARE_NAME = "lpddr4_pmu_train_1d_imem.bin lpddr4_pmu_train_1d_dmem.bin lpddr4_pmu_train_2d_imem.bin lpddr4_pmu_train_2d_dmem.bin"

PREFERRED_VERSION_u-boot-imx = "2024.04"
IMAGE_BOOTLOADER = "imx-boot"
BOOT_SPACE = "65536"
LOADADDR = ""
UBOOT_SUFFIX = "bin"
UBOOT_MAKE_TARGET = ""
IMX_BOOT_SEEK = "33"

OPTEE_BIN_EXT = "8mm"

PREFERRED_PROVIDER_virtual/kernel = "linux-imx"
PREFERRED_VERSION_linux-imx = "6.1%"
PREFERRED_PROVIDER_virtual/bootloader = "u-boot-imx"

MACHINE_ESSENTIAL_EXTRA_RRECOMMENDS += " \
	firmware-imx-epdc \
	kernel-devicetree \
	linux-firmware-imx-sdma-imx7d \
"

ATF_PLATFORM = "imx8mm"
IMX_BOOT_SOC_TARGET = "iMX8MM"
```

## conf/machine/include/byteengine-imx8mp.inc
```bitbake
# Copyright (C) 2024 bytesatwork AG - https://www.bytesatwork.io
# Released under the MIT license (see COPYING.MIT for the terms)

#@TYPE: Machine
#@NAME: byteENGINE IMX8MP
#@DESCRIPTION: byteENGINE IMX8MP by bytes at work AG

MACHINEOVERRIDES =. "mx8mp:"

require conf/machine/include/imx-base.inc
require conf/machine/include/arm/armv8a/tune-cortexa53.inc

IMX_DEFAULT_BSP = "nxp"

MACHINE_FEATURES += "pci wifi bluetooth optee"

KERNEL_IMAGETYPES = "Image"

MACHINE_USES_VIVANTE_KERNEL_DRIVER_MODULE = "1"
SPL_BINARY = "spl/u-boot-spl.bin"

# Set DDR FIRMWARE
DDR_FIRMWARE_VERSION = "202006"
DDR_FIRMWARE_NAME = " \
    lpddr4_pmu_train_1d_dmem_${DDR_FIRMWARE_VERSION}.bin \
    lpddr4_pmu_train_1d_imem_${DDR_FIRMWARE_VERSION}.bin \
    lpddr4_pmu_train_2d_dmem_${DDR_FIRMWARE_VERSION}.bin \
    lpddr4_pmu_train_2d_imem_${DDR_FIRMWARE_VERSION}.bin \
"

IMX_DEFAULT_BOOTLOADER:use-nxp-bsp = "u-boot-imx"

PREFERRED_VERSION_u-boot-imx = "2024.04"
IMAGE_BOOTLOADER = "imx-boot"
BOOT_SPACE = "65536"
LOADADDR = ""
UBOOT_MAKE_TARGET = "all"
UBOOT_SUFFIX = "bin"
UBOOT_MAKE_TARGET = ""
IMX_BOOT_SEEK = "32"

# Set serial console to uart1 (patch)
SOC_ATF_BOOT_UART_BASE:mx8m-generic-bsp = "0x30860000"
ATF_PLATFORM = "imx8mp"

OPTEE_BIN_EXT = "8mp"
TEE_LOAD_ADDR = "0x56000000"

PREFERRED_PROVIDER_virtual/kernel = "linux-imx"
PREFERRED_VERSION_linux-imx = "6.6%"
PREFERRED_PROVIDER_virtual/bootloader = "u-boot-imx"

MACHINE_ESSENTIAL_EXTRA_RRECOMMENDS += " \
	firmware-imx-epdc \
	kernel-devicetree \
	linux-firmware-imx-sdma-imx7d \
"

ATF_PLATFORM = "imx8mp"
IMX_BOOT_SOC_TARGET = "iMX8MP"
```

## conf/machine/include/byteengine-imx93.inc
```bitbake
# Copyright (C) 2024 bytesatwork AG - https://www.bytesatwork.io
# Released under the MIT license (see COPYING.MIT for the terms)

#@TYPE: Machine
#@NAME: byteENGINE IMX93
#@DESCRIPTION: byteENGINE IMX93 by bytesatwork AG

MACHINEOVERRIDES =. "mx93:"

require conf/machine/include/imx-base.inc
require conf/machine/include/arm/armv8-2a/tune-cortexa55.inc

MACHINE_FEATURES += "pci wifi bluetooth"
MACHINE_FEATURES:append:use-nxp-bsp = " optee jailhouse nxpiw612-sdio"

IMX_DEFAULT_BOOTLOADER:use-nxp-bsp = "u-boot-imx"

PREFERRED_VERSION_u-boot-imx = "2024.04"
IMAGE_BOOTLOADER = "imx-boot"
LOADADDR = ""
UBOOT_SUFFIX = "bin"
UBOOT_MAKE_TARGET = ""

SPL_BINARY = "spl/u-boot-spl.bin"

ATF_PLATFORM = "imx93"

IMX_BOOT_SOC_TARGET = "iMX9"
IMX_BOOT_SEEK = "32"

IMX_DEFAULT_BSP = "nxp"

PREFERRED_PROVIDER_virtual/kernel = "linux-imx"
PREFERRED_VERSION_linux-imx = "6.6%"
IMAGE_INSTALL:append = " kernel-devicetree"

UBOOT_CONFIG_BASENAME = "imx93_bytedevkit"

DDR_FIRMWARE_NAME = " \
    lpddr4_dmem_1d_v202201.bin \
    lpddr4_dmem_2d_v202201.bin \
    lpddr4_imem_1d_v202201.bin \
    lpddr4_imem_2d_v202201.bin \
"
```
